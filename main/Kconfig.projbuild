## main/Kconfig.projbuild
```kconfig
menu "HowdyScreen Configuration"

    menu "WiFi Settings"
        config HOWDY_WIFI_SSID
            string "WiFi SSID"
            default "YourWiFiNetwork"
            help
                WiFi network name (SSID) to connect to.
                Configure this with your actual WiFi network name.

        config HOWDY_WIFI_PASSWORD
            string "WiFi Password"  
            default "YourWiFiPassword"
            help
                WiFi network password (WPA/WPA2).
                Leave blank for open networks.
                
        config HOWDY_WIFI_MAX_RETRY
            int "Maximum WiFi connection retries"
            default 5
            range 1 10
            help
                Maximum number of attempts to connect to WiFi before giving up.
    endmenu

    menu "HowdyTTS Server Settings"

        config HOWDY_SERVER_IP
            string "HowdyTTS Server IP/Hostname"
            default "192.168.1.100"
            help
                IP address or hostname of your computer running HowdyTTS.
                Can use mDNS name like "howdytts.local" if mDNS is enabled.
                
        config HOWDY_SERVER_PORT
            int "HowdyTTS Server Port"
            default 8080
            range 1 65535
            help
                Port number for HowdyTTS WebSocket server.
                
        config HOWDY_AUTO_DISCOVER
            bool "Enable automatic server discovery"
            default y
            help
                Use mDNS to automatically discover HowdyTTS servers on the network.
    endmenu

    menu "Device Configuration"
        config HOWDY_DEVICE_ROOM
            string "Room Name"
            default "Living Room"
            help
                Name of the room where this ESP32-P4 device is located.
                This helps the HowdyTTS server identify and target specific rooms.
                Examples: "Living Room", "Kitchen", "Bedroom", "Office"
                
        config HOWDY_DEVICE_NAME
            string "Device Name"
            default "HowdyScreen"
            help
                Custom name for this ESP32-P4 device.
                Will be displayed in HowdyTTS server device list.
                Examples: "Kitchen Display", "Bedroom Assistant", "Main Screen"
    endmenu
    
    config HOWDY_AUDIO_TASK_PRIORITY
        int "Audio Task Priority"
        default 23
        range 1 25
        help
            FreeRTOS priority for audio capture task

    config HOWDY_USE_ESP_WIFI_REMOTE
        bool "Use ESP32-C6 WiFi Remote"
        default y
        help
            Enable ESP32-C6 co-processor for WiFi connectivity via SDIO

    menu "SDIO Pin Configuration"
        depends on HOWDY_USE_ESP_WIFI_REMOTE

        config HOWDY_SDIO_CLK_GPIO
            int "SDIO Clock GPIO"
            default 36
            help
                GPIO pin for SDIO clock line

        config HOWDY_SDIO_CMD_GPIO
            int "SDIO Command GPIO" 
            default 37
            help
                GPIO pin for SDIO command line

        config HOWDY_SDIO_D0_GPIO
            int "SDIO Data 0 GPIO"
            default 35
            help
                GPIO pin for SDIO data line 0

        config HOWDY_SDIO_D1_GPIO
            int "SDIO Data 1 GPIO"
            default 34
            help
                GPIO pin for SDIO data line 1

        config HOWDY_SDIO_D2_GPIO
            int "SDIO Data 2 GPIO"
            default 33
            help
                GPIO pin for SDIO data line 2

        config HOWDY_SDIO_D3_GPIO
            int "SDIO Data 3 GPIO"
            default 48
            help
                GPIO pin for SDIO data line 3

        config HOWDY_SLAVE_RESET_GPIO
            int "ESP32-C6 Reset GPIO"
            default 47
            help
                GPIO pin for ESP32-C6 reset line
    endmenu

    config WEBSOCKET_BUFFER_SIZE
        int "WebSocket Buffer Size"
        default 2048
        help
            Buffer size for WebSocket communication

    menu "Network Discovery"
        config MDNS_ENABLED
            bool "Enable mDNS Service"
            default y
            help
                Enable mDNS for automatic service discovery.
                Required for auto-discovering HowdyTTS servers.

        config MDNS_HOSTNAME
            string "Device mDNS Hostname"
            default "howdyscreen"
            depends on MDNS_ENABLED
            help
                Hostname for this device in mDNS service advertisement.
                Will be accessible as <hostname>.local on the network.
    endmenu
    
    menu "Display Settings"
        config DISPLAY_BRIGHTNESS
            int "Default Display Brightness (%)"
            default 80
            range 10 100
            help
                Default brightness level for the display (10-100%).
                
        config DISPLAY_DEMO_MODE
            bool "Enable Demo Mode"
            default n
            help
                Enable demo mode to cycle through voice assistant states.
                Useful for testing without network connection.
    endmenu
endmenu
```

## sdkconfig.defaults
```kconfig
# ESP32-P4 specific
CONFIG_IDF_TARGET="esp32p4"
CONFIG_IDF_TARGET_ESP32P4=y

# FreeRTOS
CONFIG_FREERTOS_HZ=1000
CONFIG_FREERTOS_UNICORE=n

# ESP32-P4 + ESP32-C6 WiFi Remote Configuration (FIXED for v0.12.1+)
# Disable native WiFi (P4 has none)
CONFIG_ESP_WIFI_ENABLED=n
CONFIG_SOC_WIFI_SUPPORTED=n

# Enable WiFi Remote 
CONFIG_ESP_WIFI_REMOTE_ENABLED=y
CONFIG_SLAVE_IDF_TARGET="esp32c6"
CONFIG_SLAVE_SOC_WIFI_SUPPORTED=y

# ESP-Hosted Transport Configuration
CONFIG_ESP_HOSTED_ENABLED=y
CONFIG_ESP_HOSTED_HOST=y
CONFIG_ESP_HOSTED_TRANSPORT_SDIO=y

# WiFi Performance Settings (for remote connection)
CONFIG_ESP_WIFI_STATIC_RX_BUFFER_NUM=16
CONFIG_ESP_WIFI_DYNAMIC_RX_BUFFER_NUM=64
CONFIG_ESP_WIFI_DYNAMIC_TX_BUFFER_NUM=64
CONFIG_ESP_WIFI_AMPDU_TX_ENABLED=y
CONFIG_ESP_WIFI_TX_BA_WIN=32
CONFIG_ESP_WIFI_AMPDU_RX_ENABLED=y
CONFIG_ESP_WIFI_RX_BA_WIN=32

# HowdyScreen specific ESP32-C6 WiFi remote
CONFIG_HOWDY_USE_ESP_WIFI_REMOTE=y
CONFIG_HOWDY_SDIO_CLK_GPIO=36
CONFIG_HOWDY_SDIO_CMD_GPIO=37
CONFIG_HOWDY_SDIO_D0_GPIO=35
CONFIG_HOWDY_SDIO_D1_GPIO=34
CONFIG_HOWDY_SDIO_D2_GPIO=33
CONFIG_HOWDY_SDIO_D3_GPIO=48
CONFIG_HOWDY_SLAVE_RESET_GPIO=47

# LWIP
CONFIG_LWIP_LOCAL_HOSTNAME="HowdyScreen"
CONFIG_LWIP_TCP_MSS=1436

# Audio - ESP32-P4 specific I2S
CONFIG_I2S_ENABLE_DEBUG_LOG=n
CONFIG_I2S_ISR_IRAM_SAFE=y

# Display - LVGL Configuration for ESP32-P4 with PSRAM (from working demo)
CONFIG_LV_USE_USER_DATA=y
CONFIG_LV_COLOR_16_SWAP=y
CONFIG_LV_MEM_SIZE_KILOBYTES=512
CONFIG_LV_COLOR_DEPTH_16=y
CONFIG_LV_USE_CLIB_MALLOC=y
CONFIG_LV_USE_CLIB_STRING=y
CONFIG_LV_USE_CLIB_SPRINTF=y
CONFIG_LV_ATTRIBUTE_FAST_MEM_USE_IRAM=y

# Memory configuration for ESP32-P4
CONFIG_ESP_MAIN_TASK_STACK_SIZE=8192
CONFIG_ESP_SYSTEM_EVENT_TASK_STACK_SIZE=4096

# Partition Table
CONFIG_PARTITION_TABLE_CUSTOM=y
CONFIG_PARTITION_TABLE_CUSTOM_FILENAME="partitions.csv"

# WebSocket
CONFIG_WEBSOCKET_BUFFER_SIZE=2048

# mDNS
CONFIG_MDNS_ENABLED=y
CONFIG_MDNS_HOSTNAME="howdyscreen"

# ESP32-P4 Clock configuration
# Note: ESP32-P4 runs at 400MHz by default

# Reduced Logging for Performance (was DEBUG)
CONFIG_LOG_DEFAULT_LEVEL_INFO=y
CONFIG_LOG_MAXIMUM_LEVEL_INFO=y

# Display - Waveshare 3.4" LCD Configuration (CRITICAL FIX)
CONFIG_BSP_LCD_TYPE_800_800_3_4_INCH=y

# Display color format (optional, RGB565 is default)
CONFIG_BSP_LCD_COLOR_FORMAT_RGB565=y

# Display buffer configuration (Phase 1 working solution - single framebuffer)
CONFIG_BSP_LCD_DPI_BUFFER_NUMS=1
CONFIG_BSP_DISPLAY_LVGL_AVOID_TEAR=n
CONFIG_BSP_DISPLAY_LVGL_FULL_REFRESH=n
CONFIG_BSP_DISPLAY_LVGL_BUFF_SIZE=40
CONFIG_BSP_DISPLAY_LVGL_BUFF_CAPS=MALLOC_CAP_INTERNAL

# Display brightness control
CONFIG_BSP_DISPLAY_BRIGHTNESS_LEDC_CH=1

# Flash configuration
CONFIG_ESPTOOLPY_FLASHSIZE_16MB=y

# SPIRAM Configuration (REQUIRED for 800x800 framebuffer) - Phase 1 working solution
CONFIG_SPIRAM=y
CONFIG_SPIRAM_SPEED_80M=y
CONFIG_SPIRAM_MODE_QUAD=y
CONFIG_SPIRAM_USE_MALLOC=y
CONFIG_SPIRAM_MALLOC_ALWAYSINTERNAL=2048
CONFIG_SPIRAM_TRY_ALLOCATE_WIFI_LWIP=y

# Cache Configuration (from working demo)
CONFIG_CACHE_L2_CACHE_256KB=y
CONFIG_CACHE_L2_CACHE_LINE_128B=y

# Task Configuration (from working demo)
CONFIG_ESP_MAIN_TASK_STACK_SIZE=10240
CONFIG_FREERTOS_HZ=1000

# Disable watchdog for debugging
CONFIG_ESP_TASK_WDT_EN=n

# Performance optimization
CONFIG_COMPILER_OPTIMIZATION_PERF=y

# LVGL Font Configuration (from working demo)
CONFIG_LV_FONT_MONTSERRAT_16=y
CONFIG_LV_FONT_MONTSERRAT_24=y
CONFIG_LV_FONT_MONTSERRAT_32=y
```
